## drivers/memkernel/Kconfig
```kconfig
# SPDX-License-Identifier: GPL-2.0 OR MIT

config MEMKERNEL
    tristate "Physical Mem Operation Driver"
    default y
    help
      Read-Write physical memory of target process.
      Also retrieves base address of any library within any target process.
```
